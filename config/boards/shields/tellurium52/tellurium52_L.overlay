#include "tellurium52.dtsi"

// 【本番構成】チャーリープレックス方式に復帰。
// 26キーを識別するにはこの方式が必要(マトリクス方式では20マスしか無く、
// SW14〜26 が SW1〜13 と同じ座標になってしまうため)。
// 幽霊イベントの原因は「金属ピンセットを手で握って測っていたこと」だったので、
// この方式自体には問題が無かった可能性が高い。
&kscan0 {
    // xiao_d の中継を経由せず、GPIOコントローラを直接指定してプルダウンを確実にする。
    //   D0=P0.02 D1=P0.03 D2=P0.28 D3=P0.29 D4=P0.04
    //   D5=P0.05 D6=P1.11 D7=P1.12 D8=P1.13
    gpios
        = <&gpio0  2 GPIO_ACTIVE_HIGH> // D0 = Row0
        , <&gpio0  3 GPIO_ACTIVE_HIGH> // D1 = Row1
        , <&gpio0 28 GPIO_ACTIVE_HIGH> // D2 = Row2
        , <&gpio0 29 GPIO_ACTIVE_HIGH> // D3 = Row3
        , <&gpio0  4 GPIO_ACTIVE_HIGH> // D4 = Row4
        , <&gpio0  5 GPIO_ACTIVE_HIGH> // D5 = Col0
        , <&gpio1 11 GPIO_ACTIVE_HIGH> // D6 = Col1
        , <&gpio1 12 GPIO_ACTIVE_HIGH> // D7 = Col2
        , <&gpio1 13 GPIO_ACTIVE_HIGH> // D8 = Col3
        ;
};

// エンコーダーの定義と並び順は tellurium52.dtsi に集約してある。
// (左右で番号を一致させないと、子機のエンコーダーが親機の0番として
//  扱われてしまうため。詳しくは dtsi のコメント参照)
// ここでは自分側だけを有効にする。
&left_encoder {
    status = "okay";
};
